## Documentation/devicetree/bindings/dma/keystone-pktdma.txt
```
Keystone Packet DMA Controller

This document explains the device tree bindings for the packet dma
on keystone devices. The the Network coprocessor, Cypto engines
and the SRIO on Keystone devices all have their own packet dma modules.
Each individual packet dma has a certain number of RX channels,
RX flows and TX channels. Each instance of the packet DMA is being
initialized through device specific bindings.

* DMA controller

Required properties:
 - compatible: Should be "ti,keystone-pktdma"
 - reg: Should contain register location and length of the following pktdma
	register regions. The value for "reg-names" property of the respective
	region is specified in parenthesis.
	- Global control register region (global).
	- Tx DMA channel configuration register region (txchan).
	- Rx DMA channel configuration register region (rxchan).
	- Tx DMA channel Scheduler configuration register region (txsched).
	- Rx DMA flow configuration register region (rxflow).
 - reg-names: Names for the above regions. The name to be used is specified in
	      the above description of "reg" property.
 - qm-base-address: Base address of the logical queue managers for pktdma.
 - #dma-cells: Has to be 1. Keystone-pktdma doesn't support anything else.

Optional properties:
 - enable-all: Enable all DMA channels.
 - loop-back: To loopback Tx streaming I/F to Rx streaming I/F. Used for
	      infrastructure transfers.
 - rx-retry-timeout: Number of pktdma cycles to wait before retry on buffer
		     starvation.

Example:
	netcp-dma: pktdma@2004000 {
		compatible = "ti,keystone-pktdma";
		reg =	<0x2004000 0x100>,
			<0x2004400 0x120>,
			<0x2004800 0x300>,
			<0x2004c00 0x120>,
			<0x2005000 0x400>;
		reg-names = "global", "txchan", "rxchan", "txsched",
			     "rxflow";
		qm-base-address = <0x23a80000 0x23a90000
				   0x23aa0000 0x23ab0000>;
		#dma-cells = <1>;
		/* enable-all; */
		rx-retry-timeout = <3500>;
		/* loop-back; */
	};


* DMA client

Required properties:
- dmas: One DMA request specifier consisting of a phandle to the DMA controller
	followed by the integer specifying the channel identifier. The channel
	identifier is encoded as follows:
	- bits 7-0: Tx DMA channel number or the Rx flow number.
	- bits 31-24: Channel type. 0xff for Tx DMA channel & 0xfe for Rx flow.
- dma-names: List of string identifiers for the DMA requests.

Example:

	netcp: netcp@2090000 {
		...
		dmas =	<&netcpdma KEYSTONE_DMA_RX_FLOW(22)>,
			<&netcpdma KEYSTONE_DMA_RX_FLOW(23)>,
			<&netcpdma KEYSTONE_DMA_TX_CHAN(8)>;
			dma-names = "netrx0", "netrx1", "nettx";
		...
	};
```

## Documentation/devicetree/bindings/soc/keystone-qmss.txt
```
* Texas Instruments Keystone QMSS driver

Required properties:
- compatible	: Must be "ti,keystone-qmss";
- clocks	: phandle to the reference clock for this device.
- queue-range	: <start number> total range of queue numbers for the device.
- linkram0	: <address size> for internal link ram, where size is the total
		  link ram entries.
- linkram1	: <address size> for external link ram, where size is the total
		  external link ram entries. If the address is specified as "0"
		  driver will allocate memory.
- qmgrs         : the number of individual queue managers in the device. On
                  keystone 1 range of devices there should be only one node.
		  On keystone 2 devices there can be more than 1 node.
  -- managed-queues	: the actual queues managed by each queue manager
			  instance, specified as <"base queue #" "# of queues">.
  -- reg		: Address and length of the register set for the device
			  for peek, status, config, region, push, pop regions.
  -- reg-names		: Names for the above register regions. The name to be
			  used is as follows:
			  - "config" : Queue configuration region.
			  - "status" : Queue status RAM.
			  - "region" : Descriptor memory setup region.
			  - "push"   : Queue Management/Queue Proxy region.
			  - "pop"    : Queue Management/Queue Proxy region.
			  - "peek"   : Queue Peek region.
- queue-pools	: Queue ranges are grouped into 3 type of pools:
		  - qpend	    : pool of qpend(interruptible) queues
		  - general-purpose : pool of general queues, primarly used
				      as free descriptor queues or the
				      transmit DMA queues.
		  - accumulator	    : pool of queues on accumulator channel
		  Each range can have the following properties:
  -- values		: number of queues to use per queue range, specified as
			  <"base queue #" "# of queues">.
  -- interrupts		: Optional property to specify the interrupt mapping
			  for interruptible queues. The driver additionaly sets
			  the interrupt affinity based on the cpu mask.
  -- reserved		: Optional property used to reserve the range. Queues
			  in a reserved range can only be allocated by id.
  -- accumulator	: Accumulator channel property specified as:
			  <pdsp-id, channel, entries, pacing mode, latency>
			  pdsp-id     : QMSS PDSP running accumulator firmware
					on which the channel has to be
					configured
			  channel     : Accumulator channel number
			  entries     : Size of the accumulator descriptor list
			  pacing mode : Interrupt pacing mode
					0 : None, i.e interrupt on list full
					1 : Time delay since last interrupt
					2 : Time delay since first new packet
					3 : Time delay since last new packet
			  latency     : time to delay the interrupt, specified
					in microseconds.
  -- multi-queue	: Optional property to specify that the channel has to
			  monitor upto 32 queues starting at the base queue #.
- descriptor-regions	: Descriptor memory region specification.
  -- id				: region number.
  -- values			: number of descriptors in the region,
				  specified as
				  <"# of descriptors" "descriptor size">.
  -- link-index			: start index, i.e. index of the first
				  descriptor in the region.

Optional properties:
- dma-coherent	: Present if DMA operations are coherent.
- pdsps		: PDSP configuration, if any.
  -- firmware		: firmware to be loaded on the PDSP.
  -- id			: the qmss pdsp that will run the firmware.
  -- reg		: Address and length of the register set of the PDSP
			  for iram, intd, region, command regions.
  -- reg-names		: Names for the above register regions. The name to be
			  used is as follows:
			  - "iram"   : PDSP internal RAM region.
			  - "reg"    : PDSP control/status region registers.
			  - "intd"   : QMSS interrupt distributor registers.
			  - "cmd"    : PDSP command interface region.

Example:

qmss: qmss@2a40000 {
	compatible = "ti,keystone-qmss";
	dma-coherent;
	#address-cells = <1>;
	#size-cells = <1>;
	clocks = <&chipclk13>;
	ranges;
	queue-range	= <0 0x4000>;
	linkram0	= <0x100000 0x8000>;
	linkram1	= <0x0 0x10000>;

	qmgrs {
		#address-cells = <1>;
		#size-cells = <1>;
		ranges;
		qmgr0 {
			managed-queues = <0 0x2000>;
			reg = <0x2a40000 0x20000>,
			      <0x2a06000 0x400>,
			      <0x2a02000 0x1000>,
			      <0x2a03000 0x1000>,
			      <0x2a80000 0x20000>,
			      <0x2a80000 0x20000>;
			reg-names = "peek", "status", "config",
				    "region", "push", "pop";
		};

		qmgr1 {
			managed-queues = <0x2000 0x2000>;
			reg = <0x2a60000 0x20000>,
			      <0x2a06400 0x400>,
			      <0x2a04000 0x1000>,
			      <0x2a05000 0x1000>,
			      <0x2aa0000 0x20000>,
			      <0x2aa0000 0x20000>;
			reg-names = "peek", "status", "config",
				    "region", "push", "pop";
		};
	};
	queue-pools {
		qpend {
			qpend-0 {
				values = <658 8>;
				interrupts =<0 40 0xf04 0 41 0xf04 0 42 0xf04
					     0 43 0xf04 0 44 0xf04 0 45 0xf04
					     0 46 0xf04 0 47 0xf04>;
			};
			qpend-1 {
				values = <8704 16>;
				interrupts = <0 48 0xf04 0 49 0xf04 0 50 0xf04
					      0 51 0xf04 0 52 0xf04 0 53 0xf04
					      0 54 0xf04 0 55 0xf04 0 56 0xf04
					      0 57 0xf04 0 58 0xf04 0 59 0xf04
					      0 60 0xf04 0 61 0xf04 0 62 0xf04
					      0 63 0xf04>;
				reserved;
			};
			qpend-2 {
				values = <8720 16>;
				interrupts = <0 64 0xf04 0 65 0xf04 0 66 0xf04
					      0 59 0xf04 0 68 0xf04 0 69 0xf04
					      0 70 0xf04 0 71 0xf04 0 72 0xf04
					      0 73 0xf04 0 74 0xf04 0 75 0xf04
					      0 76 0xf04 0 77 0xf04 0 78 0xf04
					      0 79 0xf04>;
			};
		};
		general-purpose {
			gp-0 {
				values = <4000 64>;
			};
			netcp-tx {
				values = <640 9>;
				reserved;
			};
		};
		accumulator {
			acc-0 {
				values = <128 32>;
				accumulator = <0 36 16 2 50>;
				interrupts = <0 215 0xf01>;
				multi-queue;
				reserved;
			};
			acc-1 {
				values = <160 32>;
				accumulator = <0 37 16 2 50>;
				interrupts = <0 216 0xf01>;
				multi-queue;
			};
			acc-2 {
				values = <192 32>;
				accumulator = <0 38 16 2 50>;
				interrupts = <0 217 0xf01>;
				multi-queue;
			};
			acc-3 {
				values = <224 32>;
				accumulator = <0 39 16 2 50>;
				interrupts = <0 218 0xf01>;
				multi-queue;
			};
		};
	};
	descriptor-regions {
		#address-cells = <1>;
		#size-cells = <1>;
		ranges;
		region-12 {
			id = <12>;
			values	= <8192 128>;	/* num_desc desc_size */
			link-index = <0x4000>;
		};
	};
	pdsps {
		#address-cells = <1>;
		#size-cells = <1>;
		ranges;
		pdsp0@0x2a10000 {
			firmware = "keystone/qmss_pdsp_acc48_k2_le_1_0_0_8.fw";
			reg = <0x2a10000 0x1000>,
			      <0x2a0f000 0x100>,
			      <0x2a0c000 0x3c8>,
			      <0x2a20000 0x4000>;
			reg-names = "iram", "reg", "intd", "cmd";
			id = <0>;
		};
	};
}; /* qmss */
```

## drivers/soc/keystone/Kconfig
```kconfig
#
# TI Keystone Soc drivers
#

config KEYSTONE_QMSS
	tristate "Keystone Queue Manager Sub System"
	depends on ARCH_KEYSTONE
	help
	  Say y here to support the Keystone Hardware Queue Manager support.
	  The Queue Manager is a hardware module that is responsible for
	  accelerating management of the packet queues. Packets are queued/
	  de-queued by writing/reading descriptor address to a particular
	  memory mapped location in the Queue Manager module.

	  If unsure, say N.
```
